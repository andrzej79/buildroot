## package/btop/Config.in
```kconfig
config BR2_PACKAGE_BTOP
	bool "btop"
	depends on BR2_INSTALL_LIBSTDCPP
	depends on BR2_TOOLCHAIN_GCC_AT_LEAST_10 # C++20
	depends on BR2_TOOLCHAIN_HAS_THREADS
	depends on BR2_USE_WCHAR
	help
	  Resource monitor that shows usage and stats for processor,
	  memory, disks, network and processes.

	  https://github.com/aristocratos/btop

comment "btop needs a toolchain w/ C++, threads, wchar, gcc >= 10"
	depends on !BR2_INSTALL_LIBSTDCPP || \
		!BR2_TOOLCHAIN_GCC_AT_LEAST_10 || \
		!BR2_TOOLCHAIN_HAS_THREADS || !BR2_USE_WCHAR
```
